## components/barcode/Kconfig
```kconfig
menu "Barcode Scanner (UART)"
    config BARCODE_TX_PIN
        int "TX Pin"
        default 15
        help
            GPIO connected to Scanner's RX.

    config BARCODE_RX_PIN
        int "RX Pin"
        default 13
        help
            GPIO connected to Scanner's TX.

    config BARCODE_BAUD_RATE
        int "Baud Rate"
        default 9600

    config BARCODE_DELIMITER
        int "Delimiter (ASCII)"
        default 13
        help
            ASCII value of the delimiter character. 13 is CR.

    config MAX_BARCODE_BUFFER_SIZE
        int "Max Barcode Length"
        default 30
endmenu
```

## components/display/Kconfig
```kconfig
menu "Display (SPI/ILI9341)"
    config TFT_MISO
        int "MISO Pin"
        default 19

    config TFT_MOSI
        int "MOSI Pin"
        default 23

    config TFT_SCLK
        int "SCLK Pin"
        default 18

    config TFT_CS
        int "CS Pin"
        default 32

    config TFT_DC
        int "DC Pin"
        default 26

    config TFT_RST
        int "RST Pin"
        default 25

    config LED_PIN
        int "LED Pin"
        default 27
        help
            When LED pin on the display is perma VCC connected, set to -1.
            Otherwise, setting the pin allows dimming.
endmenu
```

## components/network/Kconfig
```kconfig
menu "WiFi Configuration"
    config WIFI_SSID
        string "WiFi SSID"
        default ""

    config WIFI_PASSWORD
        string "WiFi Password"
        default ""
endmenu

menu "MQTT Configuration"
    config MQTT_BROKER_URI
        string "MQTT broker URI"
        default "mqtts://192.168.1.19:8883"
        help
            URI of the MQTT broker (scheme://host:port). Use mqtts:// for SSL.

    config MQTT_REQ_TOPIC_PREFIX
        string "Request Topic Prefix"
        default "product"
        help
            This prefix is preppended to device MAC and requested BARCODE

    config MQTT_TOPIC_CONTROL
        string "Status Control Topic"
        default "station/control"
endmenu
```

## main/Kconfig.projbuild
```kconfig
menu "OP Barcode Station Config"
    menu "Power conf"
        config DEEP_SLEEP_DURATION
            int "Deep Sleep Duration (seconds)"
            default 300
            range 1 86400
    endmenu
endmenu
```

## sdkconfig.defaults
```kconfig
CONFIG_PARTITION_TABLE_TWO_OTA_LARGE=y
CONFIG_LV_FONT_MONTSERRAT_22=y
CONFIG_LV_FONT_MONTSERRAT_30=y
CONFIG_LV_FONT_MONTSERRAT_40=y
CONFIG_LV_FONT_DEFAULT_MONTSERRAT_22=y
CONFIG_MBEDTLS_SSL_PROTO_TLS1_3=y
CONFIG_MBEDTLS_SSL_PROTO_TLS1_2=n
# do not use auto detect flash size, disables corruption check ability
CONFIG_ESPTOOLPY_FLASHSIZE_4MB=y

# disable logging for prod
CONFIG_LOG_DEFAULT_LEVEL_NONE=y
CONFIG_LOG_DEFAULT_LEVEL=0
CONFIG_LOG_MAXIMUM_LEVEL=0
CONFIG_BOOTLOADER_LOG_LEVEL_NONE=y
CONFIG_BOOTLOADER_LOG_LEVEL=0
CONFIG_LOG_BOOTLOADER_LEVEL_NONE=y
CONFIG_LOG_BOOTLOADER_LEVEL=0
```
